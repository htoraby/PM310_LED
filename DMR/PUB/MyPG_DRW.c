#include <Main.h>

const WORD c_wDRWBitmap[36][15]={
0xff7f,0x0140,0xc141,0xc141,0xc141,0xc141,0xc1c1,0xc1c1,0xc1c1,0xc141,0xc141,0xc141,0xc141,0x0140,0xff7f,
0xff7f,0x0140,0x0140,0x0140,0x0140,0x0140,0xfddf,0xfddf,0xfddf,0x0140,0x0140,0x0140,0x0140,0x0140,0xff7f,
0xe003,0x180c,0xc411,0xc221,0xc221,0xc141,0xc1c1,0xc1c1,0xc1c1,0xc141,0xc221,0xc221,0xc411,0x180c,0xe003,
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0x0000,0x0000,0x0001,0x0001,0x2001,0x2001,0x2401,0x24ff,0x2401,0x2001,0x2001,0x0001,0x0001,0x0000,0x0000
};


//-----------------------------------------------------------------------------
WORD PGDRW_GetStatusLinkIN(WORD wLinkIN)
{
	WORD wStatusLinkIN;
	if(wLinkIN==0) return 0;
	wLinkIN--;
	wStatusLinkIN = 0;
	if(wLinkIN<32)
	{
		if(wLinkIN<16) wStatusLinkIN = g_deviceInfo.wSwitchStatus1&(SS_IN01<<wLinkIN);
		else if(wLinkIN<32) wStatusLinkIN = g_deviceInfo.wSwitchStatus2&(SS_IN01<<(wLinkIN-16));
	}
#ifdef _CMYPROTECT_H
	else if(wLinkIN<64)
	{
		wStatusLinkIN = (g_wProtectRun[wLinkIN-32]==PROTECTTOG_ON)?1:0;
	}
#endif/*_CMYPROTECT_H*/
	else return 0;
	return (wStatusLinkIN)?0x5555:0x3333;
}

void PGDRW_DrawHLine(DRW_HLINE* pDRW)
{
	g_wLCDAutoPosX = pDRW->wPointX+pDRW->wLength;
	switch(pDRW->wLineType)
	{
	case 0: LCD_DrawHLineExt(pDRW->wPointY,pDRW->wPointX,g_wLCDAutoPosX,0xaa); break;
	case 2:
		LCD_DrawHLine((WORD)(pDRW->wPointY-1),pDRW->wPointX,g_wLCDAutoPosX);
		LCD_DrawHLine((WORD)(pDRW->wPointY+1),pDRW->wPointX,g_wLCDAutoPosX);
	case 1:
		LCD_DrawHLine(pDRW->wPointY,pDRW->wPointX,g_wLCDAutoPosX);
		break;
	}
}

void PGDRW_DrawVLine(DRW_VLINE* pDRW)
{
	g_wLCDAutoPosY = pDRW->wPointY+pDRW->wLength;
	switch(pDRW->wLineType)
	{
	case 0: LCD_DrawVLineExt(pDRW->wPointX,pDRW->wPointY,g_wLCDAutoPosY,0xaa); break;
	case 2:
		LCD_DrawVLine((WORD)(pDRW->wPointX-1),pDRW->wPointY,g_wLCDAutoPosY);
		LCD_DrawVLine((WORD)(pDRW->wPointX+1),pDRW->wPointY,g_wLCDAutoPosY);
	case 1:
		LCD_DrawVLine(pDRW->wPointX,pDRW->wPointY,g_wLCDAutoPosY);
		break;
	}
}

void PGDRW_DrawXLine(DRW_XLINE* pDRW)
{
	g_wLCDAutoPosX = pDRW->wPointX+pDRW->wWidth;
	g_wLCDAutoPosY = pDRW->wPointY+pDRW->wHeight;
	if(pDRW->bTopLeft)
	{
		LCD_DrawXLine(pDRW->wPointX,pDRW->wPointY,g_wLCDAutoPosX,g_wLCDAutoPosY);
	}
	else
	{
		LCD_DrawXLine(pDRW->wPointX,g_wLCDAutoPosY,g_wLCDAutoPosX,pDRW->wPointY);
	}
}

void PGDRW_DrawCircle(DRW_CIRCLE* pDRW)
{
	LCD_DrawCircle(pDRW->wPointX,pDRW->wPointY,pDRW->wRadio);
}

void PGDRW_DrawErase(DRW_ERASE* pDRW)
{
	WORD wLCDColorOld;
	WORD i;

	wLCDColorOld = g_wLCDColor;
	LCD_SetColor(g_wLCDColorBK);
	for(i=0;i<pDRW->wHeight;i++)
	{
		LCD_DrawHLine((WORD)(pDRW->wPointY+i),pDRW->wPointX,(WORD)(pDRW->wPointX+pDRW->wWidth));
	}
	LCD_SetColor(wLCDColorOld);
}

void PGDRW_DrawText(DRW_TEXT* pDRW)
{
	char szText[10];
	WORD wLength;
	BOOL bModeASCII;
	WORD i;

	wLength = pDRW->wszText[0]&0xff;
	if(wLength>9) wLength = 9;
	szText[0] = (char)(pDRW->wszText[0]>>8);
	szText[1] = (char)(pDRW->wszText[1]&0xff);
	szText[2] = (char)(pDRW->wszText[1]>>8);
	szText[3] = (char)(pDRW->wszText[2]&0xff);
	szText[4] = (char)(pDRW->wszText[2]>>8);
	szText[5] = (char)(pDRW->wszText[3]&0xff);
	szText[6] = (char)(pDRW->wszText[3]>>8);
	szText[7] = (char)(pDRW->wszText[4]&0xff);
	szText[8] = (char)(pDRW->wszText[4]>>8);
	szText[wLength] = 0;
	bModeASCII = TRUE;
	for(i=0;i<wLength;i++)
	{
		if((BYTE)szText[i]>=128) bModeASCII = FALSE;
	}
	if(bModeASCII) LCD_AsciiOut((WORD)(pDRW->wPointX+1),pDRW->wPointY,szText);
	else LCD_TextOut(pDRW->wPointX,pDRW->wPointY,szText);
}

void PGDRW_DrawAnalog(DRW_ANALOG* pDRW)
{
	g_wLCDAutoPosX = pDRW->wPointX+1;
	g_wLCDAutoPosY = pDRW->wPointY;
	if(pDRW->wLinkAnalog) MyHMI_AutoLCDDataOut((WORD)(INDEX_ANALOG+pDRW->wLinkAnalog));
	else LCD_AutoAsciiOut("----");
}

void PGDRW_DrawBlock(DRW_BLOCK* pDRW)
{
	LCD_ImageOut(pDRW->wPointX,pDRW->wPointY,15,16,(WORD*)c_wDRWBitmap[pDRW->wBlockType+24]);
}

void PGDRW_DrawBlockDyn(DRW_BLOCKDYN* pDRW)
{
	WORD wStatusIN1;
	WORD wStatusIN2;
	WORD wIndex;

	wIndex = 0;
	wStatusIN1 = PGDRW_GetStatusLinkIN(pDRW->wLinkIN1);
	wStatusIN2 = PGDRW_GetStatusLinkIN(pDRW->wLinkIN2);

	if(wStatusIN1==0x5555) wIndex = 1;
	switch(pDRW->wBlockType)
	{
	case 0: wIndex += 0; break;
	case 1: wIndex += 2; break;
	case 2: wIndex += 4; break;
	case 3: wIndex += 6; break;
	case 4:
	case 5:
		wIndex = 0;
		if(wStatusIN2==0x5555) wIndex = 1;
		if(wStatusIN1==0x3333 && wStatusIN2==0x3333) wIndex = 2;
		if(pDRW->wBlockType==4) wIndex += 8;
		else wIndex += 11;
		break;
	case 6: wIndex += 14; break;
	case 7: wIndex += 16; break;
	case 8: wIndex += 18; break;
	case 9: wIndex += 20; break;
	case 10: wIndex += 22; break;
	default: return;
	}
	LCD_ImageOut(pDRW->wPointX,pDRW->wPointY,15,16,(WORD*)c_wDRWBitmap[wIndex]);
}

void PGDRW_OnRefreshPage(WORD wRefreshMode)
{
	WORD* pTemp;
	WORD i;
	DRW_BASE* pDRW;

	LCD_SetSmallFont();
	pTemp = g_deviceDRW.wReserved;
	for(i=0;i<g_deviceDRW.wCount;i++)
	{
		if(i>=COUNTDRWMAX) break;
		pDRW = (DRW_BASE*)pTemp;
		switch(pDRW->wType)
		{
		case DRWTYPE_HLINE:
			if(wRefreshMode) PGDRW_DrawHLine((DRW_HLINE*)pDRW);
			pTemp += SIZEOFWORD(DRW_HLINE);
			break;
		case DRWTYPE_VLINE:
			if(wRefreshMode) PGDRW_DrawVLine((DRW_VLINE*)pDRW);
			pTemp += SIZEOFWORD(DRW_VLINE);
			break;
		case DRWTYPE_XLINE:
			if(wRefreshMode) PGDRW_DrawXLine((DRW_XLINE*)pDRW);
			pTemp += SIZEOFWORD(DRW_XLINE);
			break;
		case DRWTYPE_CIRCLE:
			if(wRefreshMode) PGDRW_DrawCircle((DRW_CIRCLE*)pDRW);
			pTemp += SIZEOFWORD(DRW_CIRCLE);
			break;
		case DRWTYPE_ERASE:
			if(wRefreshMode) PGDRW_DrawErase((DRW_ERASE*)pDRW);
			pTemp += SIZEOFWORD(DRW_ERASE);
			break;
		case DRWTYPE_TEXT:
			if(wRefreshMode) PGDRW_DrawText((DRW_TEXT*)pDRW);
			pTemp += (((DRW_TEXT*)pDRW)->wszText[0]&0xff)/2+4;
			break;
		case DRWTYPE_ANALOG:
			PGDRW_DrawAnalog((DRW_ANALOG*)pDRW);
			pTemp += SIZEOFWORD(DRW_ANALOG);
			break;
		case DRWTYPE_BLOCK:
			if(wRefreshMode) PGDRW_DrawBlock((DRW_BLOCK*)pDRW);
			pTemp += SIZEOFWORD(DRW_BLOCK);
			break;
		case DRWTYPE_BLOCKDYN:
			PGDRW_DrawBlockDyn((DRW_BLOCKDYN*)pDRW);
			pTemp += SIZEOFWORD(DRW_BLOCKDYN);
			break;
		default: return;
		}
	}
	LCD_DateOut(LCD_CXDOT/2-52,LCD_CYDOT-10,g_deviceTime.wYear,g_deviceTime.wMonth,g_deviceTime.wDay);
	LCD_TimeOut(LCD_CXDOT/2+4,LCD_CYDOT-10,g_deviceTime.wHour,g_deviceTime.wMinute,g_deviceTime.wSecond,0xffff);
}
